/dts-v1/;

/ {

	fragment@0 {
		target = <0xffffffff>;

		__overlay__ {
			bootargs = "console=tty0 console=ttyMT0,921600n1 root=/dev/ram initrd=0x84000000,0x400000 loglevel=8";
			atag,videolfb-fb_base = <0x9e800000>;
			atag,videolfb-islcmfound = <0x1>;
			atag,videolfb-fps = <0x1770>;
			atag,videolfb-vramSize = <0x1800000>;
			atag,videolfb-lcmname = "nt35590_AUO";
		};
	};

	fragment@1 {
		target = <0xffffffff>;

		__overlay__ {
			compatible = "simple-bus";
			#address-cells = <0x1>;
			#size-cells = <0x1>;
			ranges = <0x0 0x0 0x0 0xffffffff>;
		};
	};

	fragment@2 {
		target = <0xffffffff>;

		__overlay__ {

			led@0 {
				compatible = "mediatek,red";
				led_mode = <0x0>;
				data = <0x1>;
				pwm_config = <0x0 0x0 0x0 0x0 0x0>;
			};

			led@1 {
				compatible = "mediatek,green";
				led_mode = <0x0>;
				data = <0x1>;
				pwm_config = <0x0 0x0 0x0 0x0 0x0>;
			};

			led@2 {
				compatible = "mediatek,blue";
				led_mode = <0x0>;
				data = <0x1>;
				pwm_config = <0x0 0x0 0x0 0x0 0x0>;
			};

			led@3 {
				compatible = "mediatek,jogball-backlight";
				led_mode = <0x0>;
				data = <0x1>;
				pwm_config = <0x0 0x0 0x0 0x0 0x0>;
			};

			led@4 {
				compatible = "mediatek,keyboard-backlight";
				led_mode = <0x0>;
				data = <0x1>;
				pwm_config = <0x0 0x0 0x0 0x0 0x0>;
			};

			led@5 {
				compatible = "mediatek,button-backlight";
				led_mode = <0x0>;
				data = <0x1>;
				pwm_config = <0x0 0x0 0x0 0x0 0x0>;
			};

			led@6 {
				compatible = "mediatek,lcd-backlight";
				led_mode = <0x5>;
				data = <0x1>;
				pwm_config = <0x0 0x0 0x0 0x0 0x0>;
			};

			vibrator@0 {
				compatible = "mediatek,vibrator";
				vib_timer = <0x19>;
				vib_limit = <0x8>;
				vib_vol = <0x6>;
				linux,phandle = <0x39>;
				phandle = <0x39>;
			};

			fm_short {
				compatible = "mediatek,short-antenna";
				gpio-short-antenna = <0xffffffff 0x14 0x0>;
				linux,phandle = <0x3a>;
				phandle = <0x3a>;
			};

			fingerprint {
				compatible = "mediatek,fingerprint_dev";
				interrupt-parent = <0xffffffff>;
				interrupts = <0xb 0x1>;
				debounce = <0xb 0x0>;
				pinctrl-names = "fingerprint_default", "fingerprint_pin_irq", "fingerprint_eint_pull_down", "fingerprint_reset_high", "fingerprint_reset_low";
				pinctrl-0 = <0x1>;
				pinctrl-1 = <0x2>;
				pinctrl-2 = <0x3>;
				pinctrl-3 = <0x4>;
				pinctrl-4 = <0x5>;
				status = "okay";
				linux,phandle = <0x3b>;
				phandle = <0x3b>;
			};

			utos {
				compatible = "microtrust,utos";
				interrupts = <0x0 0x9f 0x1 0x0 0xa0 0x1>;
			};
		};
	};

	fragment@3 {
		target = <0xffffffff>;

		__overlay__ {

			gsensor_mc34xx@4c {
				compatible = "mediatek,gsensor_mc34xx";
				reg = <0x4c>;
				i2c_num = <0x2>;
				i2c_addr = <0x4c 0x0 0x0 0x0>;
				direction = <0x1>;
				power_id = <0xffff>;
				power_vol = <0x0>;
				firlen = <0x0>;
				is_batch_supported = <0x0>;
				status = "okay";
			};

			alsps_stk3x1x@48 {
				compatible = "mediatek,alsps_stk3x1x";
				pinctrl-names = "pin_default", "pin_cfg";
				pinctrl-0 = <0x6>;
				pinctrl-1 = <0x7>;
				interrupt-parent = <0xffffffff>;
				interrupts = <0x6 0x8>;
				debounce = <0x6 0x0>;
				status = "okay";
				i2c_num = <0x2>;
				reg = <0x48>;
				i2c_addr = <0x48 0x0 0x0 0x0>;
				polling_mode_ps = <0x0>;
				polling_mode_als = <0x1>;
				power_id = <0xffff>;
				power_vol = <0x0>;
				als_level = <0x0 0x51 0x9a 0xe5 0x178 0x25f 0x2f2 0x36e 0x464 0x8c7 0x1768 0x2710 0x2710 0x2710 0x4e20>;
				als_value = <0x0 0x64 0xc8 0x12c 0x1f4 0x320 0x3e8 0x4b0 0x5dc 0xbb8 0x1f40 0x3a98 0x4e20 0x4e20 0x4e20 0x4e20>;
				ps_setting = <0x71 0x30 0x27 0x5e 0xff>;
				als_setting = <0x38>;
				ps_threshold_high = <0x1f4>;
				ps_threshold_low = <0x190>;
				is_batch_supported_ps = <0x0>;
				is_batch_supported_als = <0x0>;
			};
		};
	};

	fragment@4 {
		target = <0xffffffff>;

		__overlay__ {
			clk_src = [07];
			bus-width = <0x8>;
			max-frequency = <0xc65d400>;
			cap-mmc-highspeed;
			msdc-sys-suspend;
			mmc-hs200-1_8v;
			non-removable;
			pinctl = <0x8>;
			register_setting = <0x9>;
			host_function = [00];
			bootable;
			status = "okay";
		};
	};

	fragment@5 {
		target = <0xffffffff>;

		__overlay__ {
			clk_src = [02];
			bus-width = <0x4>;
			max-frequency = <0xc65d400>;
			msdc-sys-suspend;
			cap-sd-highspeed;
			sd-uhs-sdr12;
			sd-uhs-sdr25;
			sd-uhs-sdr50;
			sd-uhs-sdr104;
			pinctrl-names = "default", "insert_cfg";
			pinctrl-0 = <0xa>;
			pinctrl-1 = <0xb>;
			pinctl = <0xc>;
			pinctl_sdr104 = <0xd>;
			pinctl_sdr50 = <0xe>;
			pinctl_ddr50 = <0xf>;
			register_setting = <0x10>;
			host_function = [01];
			cd_level = [00];
			cd-gpios = <0xffffffff 0xa 0x0>;
			status = "okay";
		};
	};

	fragment@6 {
		target = <0xffffffff>;

		__overlay__ {

			mmc0@default {
				linux,phandle = <0x8>;
				phandle = <0x8>;

				pins_cmd {
					drive-strength = [02];
				};

				pins_dat {
					drive-strength = [02];
				};

				pins_clk {
					drive-strength = [02];
				};

				pins_rst {
					drive-strength = [02];
				};

				pins_ds {
					drive-strength = [02];
				};
			};

			mmc0@register_default {
				dat0rddly = [00];
				dat1rddly = [00];
				dat2rddly = [00];
				dat3rddly = [00];
				dat4rddly = [00];
				dat5rddly = [00];
				dat6rddly = [00];
				dat7rddly = [00];
				datwrddly = [00];
				cmdrrddly = [00];
				cmdrddly = [00];
				cmd_edge = [01];
				rdata_edge = [01];
				wdata_edge = [01];
				ett-hs200-cells = <0xc>;
				ett-hs200-default = <0xb0 0x380 0x0 0xb0 0x7c00 0x0 0xb4 0x38 0x1 0x4 0x2 0x1 0xf0 0x1f0000 0x0 0xf0 0x7c00000 0x0 0xb4 0x7 0x1 0xf0 0x1f 0x0 0x4 0x100 0x1 0xf8 0x1f000000 0x0 0xf0 0x1f00 0x0 0xb0 0x8 0x1>;
				linux,phandle = <0x9>;
				phandle = <0x9>;
			};

			mmc1@default {
				linux,phandle = <0xc>;
				phandle = <0xc>;

				pins_cmd {
					drive-strength = [03];
				};

				pins_dat {
					drive-strength = [03];
				};

				pins_clk {
					drive-strength = [03];
				};
			};

			mmc1_ins_default {
				linux,phandle = <0xa>;
				phandle = <0xa>;
			};

			mmc1_ins_cfg {
				linux,phandle = <0xb>;
				phandle = <0xb>;

				pins_insert {
					pins = <0xa06>;
					input-schmitt-enable = <0x1>;
					slew-rate = <0x0>;
					bias-pull-up = <0x0>;
				};
			};

			mmc1@sdr104 {
				linux,phandle = <0xd>;
				phandle = <0xd>;

				pins_cmd {
					drive-strength = [02];
				};

				pins_dat {
					drive-strength = [02];
				};

				pins_clk {
					drive-strength = [03];
				};
			};

			mmc1@sdr50 {
				linux,phandle = <0xe>;
				phandle = <0xe>;

				pins_cmd {
					drive-strength = [02];
				};

				pins_dat {
					drive-strength = [02];
				};

				pins_clk {
					drive-strength = [03];
				};
			};

			mmc1@ddr50 {
				linux,phandle = <0xf>;
				phandle = <0xf>;

				pins_cmd {
					drive-strength = [02];
				};

				pins_dat {
					drive-strength = [02];
				};

				pins_clk {
					drive-strength = [03];
				};
			};

			mmc1@register_default {
				dat0rddly = [00];
				dat1rddly = [00];
				dat2rddly = [00];
				dat3rddly = [00];
				datwrddly = [00];
				cmdrrddly = [00];
				cmdrddly = [00];
				cmd_edge = [01];
				rdata_edge = [01];
				wdata_edge = [01];
				linux,phandle = <0x10>;
				phandle = <0x10>;
			};
		};
	};

	fragment@7 {
		target = <0xffffffff>;

		__overlay__ {

			alspspincfg {
				linux,phandle = <0x7>;
				phandle = <0x7>;

				pins_cmd_dat {
					pins = <0x606>;
					slew-rate = <0x0>;
					bias-pull-up = <0x0>;
				};
			};

			alspsdefaultcfg {
				linux,phandle = <0x6>;
				phandle = <0x6>;
			};
		};
	};

	fragment@8 {
		target = <0xffffffff>;

		__overlay__ {
			accdet-mic-vol = <0x7>;
			headset-mode-setting = <0x500 0x200 0x1 0x1f0 0x800 0x800 0x20>;
			accdet-plugout-debounce = <0x14>;
			accdet-mic-mode = <0x1>;
			headset-three-key-threshold = <0x0 0x5a 0xf0 0x1f4>;
			headset-four-key-threshold = <0x0 0x3c 0x7e 0xc9 0x1c2>;
			pinctrl-names = "default", "state_eint_as_int";
			pinctrl-0 = <0x11>;
			pinctrl-1 = <0x12>;
			status = "okay";
		};
	};

	fragment@9 {
		target = <0xffffffff>;

		__overlay__ {

			eint0default {
				linux,phandle = <0x11>;
				phandle = <0x11>;
			};

			eint@0 {
				linux,phandle = <0x12>;
				phandle = <0x12>;

				pins_cmd_dat {
					pins = <0x1206>;
					slew-rate = <0x0>;
					bias-disable;
				};
			};
		};
	};

	fragment@10 {
		target = <0xffffffff>;

		__overlay__ {
			tpd-resolution = <0x1e0 0x3c0>;
			use-tpd-button = <0x1>;
			tpd-key-num = <0x3>;
			tpd-key-local = <0x8b 0xac 0x9e 0x0>;
			tpd-key-dim-local = <0x5a 0x373 0x64 0x28 0xe6 0x373 0x64 0x28 0x172 0x373 0x64 0x28 0x0 0x0 0x0 0x0>;
			tpd-max-touch-num = <0x5>;
			tpd-filter-pixel-density = <0x7c>;
			tpd-filter-custom-prameters = <0x0 0x0 0x0 0x0 0x0 0x0 0x0 0x0 0x0 0x0 0x0 0x0>;
			tpd-filter-custom-speed = <0x0 0x0 0x0>;
			pinctrl-names = "default", "state_eint_as_int", "state_eint_output0", "state_eint_output1", "state_rst_output0", "state_rst_output1";
			pinctrl-0 = <0x13>;
			pinctrl-1 = <0x14>;
			pinctrl-2 = <0x15>;
			pinctrl-3 = <0x16>;
			pinctrl-4 = <0x17>;
			pinctrl-5 = <0x18>;
			status = "okay";
		};
	};

	fragment@11 {
		target = <0xffffffff>;

		__overlay__ {

			toucheint5default {
				linux,phandle = <0x13>;
				phandle = <0x13>;
			};

			toucheint@5 {
				linux,phandle = <0x14>;
				phandle = <0x14>;

				pins_cmd_dat {
					pins = <0x506>;
					slew-rate = <0x0>;
					bias-disable;
				};
			};

			eintoutput0 {
				linux,phandle = <0x15>;
				phandle = <0x15>;

				pins_cmd_dat {
					pins = <0x500>;
					slew-rate = <0x1>;
					output-low;
				};
			};

			eintoutput1 {
				linux,phandle = <0x16>;
				phandle = <0x16>;

				pins_cmd_dat {
					pins = <0x500>;
					slew-rate = <0x1>;
					output-high;
				};
			};

			rstoutput0 {
				linux,phandle = <0x17>;
				phandle = <0x17>;

				pins_cmd_dat {
					pins = <0x1000>;
					slew-rate = <0x1>;
					output-low;
				};
			};

			rstoutput1 {
				linux,phandle = <0x18>;
				phandle = <0x18>;

				pins_cmd_dat {
					pins = <0x1000>;
					slew-rate = <0x1>;
					output-high;
				};
			};
		};
	};

	fragment@12 {
		target = <0xffffffff>;

		__overlay__ {
			extamp_gpio = <0xc>;
			extamp_mode = <0x3>;
			extamp_speech_mode = <0x3>;
			pinctrl-names = "default", "audpmicclk-mode0", "audpmicclk-mode1", "extamp-pullhigh", "extamp-pulllow";
			pinctrl-0 = <0x19>;
			pinctrl-1 = <0x1a>;
			pinctrl-2 = <0x1b>;
			pinctrl-3 = <0x1c>;
			pinctrl-4 = <0x1d>;
			status = "okay";
		};
	};

	fragment@13 {
		target = <0xffffffff>;

		__overlay__ {

			audiodefault {
				linux,phandle = <0x19>;
				phandle = <0x19>;
			};

			pmicclkmode0 {
				linux,phandle = <0x1a>;
				phandle = <0x1a>;

				pins_cmd0_dat {
					pins = <0x1a00>;
				};

				pins_cmd1_dat {
					pins = <0x1c00>;
				};

				pins_cmd2_dat {
					pins = <0x1b00>;
				};
			};

			pmicclkmode1 {
				linux,phandle = <0x1b>;
				phandle = <0x1b>;

				pins_cmd0_dat {
					pins = <0x1a01>;
				};

				pins_cmd1_dat {
					pins = <0x1c01>;
				};

				pins_cmd2_dat {
					pins = <0x1b01>;
				};
			};

			audexamphigh {
				linux,phandle = <0x1c>;
				phandle = <0x1c>;

				pins_cmd_dat {
					pins = <0xc00>;
					slew-rate = <0x1>;
					output-high;
				};
			};

			audexamplow {
				linux,phandle = <0x1d>;
				phandle = <0x1d>;

				pins_cmd_dat {
					pins = <0xc00>;
					slew-rate = <0x1>;
					output-low;
				};
			};
		};
	};

	fragment@14 {
		target = <0xffffffff>;

		__overlay__ {

			mode_te_gpio {
				linux,phandle = <0x1f>;
				phandle = <0x1f>;

				pins_cmd_dat {
					pins = <0x4400>;
				};
			};

			mode_te_te {
				linux,phandle = <0x20>;
				phandle = <0x20>;

				pins_cmd_dat {
					pins = <0x4401>;
				};
			};

			lcm_rst_out0_gpio {
				linux,phandle = <0x21>;
				phandle = <0x21>;

				pins_cmd_dat {
					pins = <0x4600>;
					slew-rate = <0x1>;
					output-low;
				};
			};

			lcm_rst_out1_gpio {
				linux,phandle = <0x22>;
				phandle = <0x22>;

				pins_cmd_dat {
					pins = <0x4600>;
					slew-rate = <0x1>;
					output-high;
				};
			};

			pwm_test_pin_mux_gpio66 {
				linux,phandle = <0x23>;
				phandle = <0x23>;

				pins_cmd_dat {
					pins = <0x4201>;
					slew-rate = <0x1>;
				};
			};

			mtkfb_default {
				linux,phandle = <0x1e>;
				phandle = <0x1e>;
			};
		};
	};

	fragment@15 {
		target = <0xffffffff>;

		__overlay__ {
			pinctrl-names = "default", "mode_te_gpio", "mode_te_te", "lcm_rst_out0_gpio", "lcm_rst_out1_gpio", "pwm_test_pin_mux_gpio66";
			pinctrl-0 = <0x1e>;
			pinctrl-1 = <0x1f>;
			pinctrl-2 = <0x20>;
			pinctrl-3 = <0x21>;
			pinctrl-4 = <0x22>;
			pinctrl-5 = <0x23>;
			status = "okay";
		};
	};

	fragment@16 {
		target = <0xffffffff>;

		__overlay__ {

			cam0@0 {
				linux,phandle = <0x25>;
				phandle = <0x25>;

				pins_cmd_dat {
					pins = <0x4900>;
					slew-rate = <0x1>;
					output-low;
				};
			};

			cam0@1 {
				linux,phandle = <0x26>;
				phandle = <0x26>;

				pins_cmd_dat {
					pins = <0x4900>;
					slew-rate = <0x1>;
					output-high;
				};
			};

			cam0@2 {
				linux,phandle = <0x27>;
				phandle = <0x27>;

				pins_cmd_dat {
					pins = <0x4700>;
					slew-rate = <0x1>;
					output-low;
				};
			};

			cam0@3 {
				linux,phandle = <0x28>;
				phandle = <0x28>;

				pins_cmd_dat {
					pins = <0x4700>;
					slew-rate = <0x1>;
					output-high;
				};
			};

			cam1@0 {
				linux,phandle = <0x29>;
				phandle = <0x29>;

				pins_cmd_dat {
					pins = <0x4c00>;
					slew-rate = <0x1>;
					output-low;
				};
			};

			cam1@1 {
				linux,phandle = <0x2a>;
				phandle = <0x2a>;

				pins_cmd_dat {
					pins = <0x4c00>;
					slew-rate = <0x1>;
					output-high;
				};
			};

			cam1@2 {
				linux,phandle = <0x2b>;
				phandle = <0x2b>;

				pins_cmd_dat {
					pins = <0x4a00>;
					slew-rate = <0x1>;
					output-low;
				};
			};

			cam1@3 {
				linux,phandle = <0x2c>;
				phandle = <0x2c>;

				pins_cmd_dat {
					pins = <0x4a00>;
					slew-rate = <0x1>;
					output-high;
				};
			};

			cam@0 {
				linux,phandle = <0x2d>;
				phandle = <0x2d>;

				pins_cmd_dat {
					pins = <0x4100>;
					slew-rate = <0x1>;
					output-low;
				};
			};

			cam@1 {
				linux,phandle = <0x2e>;
				phandle = <0x2e>;

				pins_cmd_dat {
					pins = <0x4100>;
					slew-rate = <0x1>;
					output-high;
				};
			};

			camdefault {
				linux,phandle = <0x24>;
				phandle = <0x24>;
			};

			cam1serial@0 {
				linux,phandle = <0x2f>;
				phandle = <0x2f>;

				pins_cmd_dat {
					pins = <0x2302>;
				};

				pins_cmd_dat1 {
					pins = <0x2402>;
				};

				pins_cmd_dat2 {
					pins = <0x2502>;
				};

				pins_cmd_dat3 {
					pins = <0x2602>;
				};

				pins_cmd_dat4 {
					pins = <0x2702>;
				};
			};

			cam1mipi@0 {
				linux,phandle = <0x30>;
				phandle = <0x30>;

				pins_cmd_dat {
					pins = <0x2301>;
				};

				pins_cmd_dat1 {
					pins = <0x2401>;
				};

				pins_cmd_dat2 {
					pins = <0x2501>;
				};

				pins_cmd_dat3 {
					pins = <0x2601>;
				};

				pins_cmd_dat4 {
					pins = <0x2701>;
				};

				pins_cmd_dat5 {
					pins = <0x2801>;
				};
			};

			mclk1enable@0 {
				linux,phandle = <0x31>;
				phandle = <0x31>;

				pins_cmd_dat {
					pins = <0x4801>;
				};
			};

			mclk1disable@0 {
				linux,phandle = <0x32>;
				phandle = <0x32>;

				pins_cmd_dat {
					pins = <0x4800>;
				};
			};

			mclk2enable@0 {
				linux,phandle = <0x33>;
				phandle = <0x33>;

				pins_cmd_dat {
					pins = <0x4b01>;
				};
			};

			mclk2disable@0 {
				linux,phandle = <0x34>;
				phandle = <0x34>;

				pins_cmd_dat {
					pins = <0x4b00>;
				};
			};
		};
	};

	fragment@17 {
		target = <0xffffffff>;

		__overlay__ {
			pinctrl-names = "default", "cam0_rst0", "cam0_rst1", "cam0_pnd0", "cam0_pnd1", "cam1_rst0", "cam1_rst1", "cam1_pnd0", "cam1_pnd1", "cam_ldo0_0", "cam_ldo0_1", "cam1_gpio_serial", "cam1_gpio_mipi", "cam_mclk1_enable", "cam_mclk1_disable", "cam_mclk2_enable", "cam_mclk2_disable";
			pinctrl-0 = <0x24>;
			pinctrl-1 = <0x25>;
			pinctrl-2 = <0x26>;
			pinctrl-3 = <0x27>;
			pinctrl-4 = <0x28>;
			pinctrl-5 = <0x29>;
			pinctrl-6 = <0x2a>;
			pinctrl-7 = <0x2b>;
			pinctrl-8 = <0x2c>;
			pinctrl-9 = <0x2d>;
			pinctrl-10 = <0x2e>;
			pinctrl-11 = <0x2f>;
			pinctrl-12 = <0x30>;
			pinctrl-13 = <0x31>;
			pinctrl-14 = <0x32>;
			pinctrl-15 = <0x33>;
			pinctrl-16 = <0x34>;
			status = "okay";
		};
	};

	fragment@18 {
		target = <0xffffffff>;

		__overlay__ {

			consys_default {
				linux,phandle = <0x35>;
				phandle = <0x35>;
			};

			gpslna@0 {
				linux,phandle = <0x36>;
				phandle = <0x36>;

				pins_cmd_dat {
					pins = <0x4500>;
					slew-rate = <0x0>;
					bias-disable;
					output-low;
				};
			};

			gpslna@1 {
				linux,phandle = <0x37>;
				phandle = <0x37>;

				pins_cmd_dat {
					pins = <0x4500>;
					slew-rate = <0x1>;
					output-high;
				};
			};

			gpslna@2 {
				linux,phandle = <0x38>;
				phandle = <0x38>;

				pins_cmd_dat {
					pins = <0x4500>;
					slew-rate = <0x1>;
					output-low;
				};
			};
		};
	};

	fragment@19 {
		target = <0xffffffff>;

		__overlay__ {
			pinctrl-names = "default", "gps_lna_state_init", "gps_lna_state_oh", "gps_lna_state_ol";
			pinctrl-0 = <0x35>;
			pinctrl-1 = <0x36>;
			pinctrl-2 = <0x37>;
			pinctrl-3 = <0x38>;
			status = "okay";
		};
	};

	fragment@20 {
		target = <0xffffffff>;

		__overlay__ {

			fingerprint_default {
				linux,phandle = <0x1>;
				phandle = <0x1>;
			};

			gpio11_eint {
				linux,phandle = <0x2>;
				phandle = <0x2>;

				pins_cmd_dat {
					pins = <0xb06>;
					slew-rate = <0x0>;
					bias-disable;
				};
			};

			gpio11_eint_pull_down {
				linux,phandle = <0x3>;
				phandle = <0x3>;

				pins_cmd_dat {
					pins = <0xb06>;
					slew-rate = <0x0>;
					bias-pull-down = <0x0>;
					output-low;
				};
			};

			rst_out_one {
				linux,phandle = <0x4>;
				phandle = <0x4>;

				pins_cmd_dat {
					pins = <0x4100>;
					slew-rate = <0x1>;
					bias-disable;
					output-high;
				};
			};

			rst_out_zero {
				linux,phandle = <0x5>;
				phandle = <0x5>;

				pins_cmd_dat {
					pins = <0x4100>;
					slew-rate = <0x1>;
					bias-disable;
					output-low;
				};
			};
		};
	};

	fragment@21 {
		target = <0xffffffff>;

		__overlay__ {
			#address-cells = <0x1>;
			#size-cells = <0x0>;

			camera_main@36 {
				compatible = "mediatek,camera_main";
				reg = <0x36>;
				status = "okay";
				linux,phandle = <0x3c>;
				phandle = <0x3c>;
			};

			camera_main_af@18 {
				compatible = "mediatek,camera_main_af";
				reg = <0x18>;
				status = "okay";
				linux,phandle = <0x3d>;
				phandle = <0x3d>;
			};

			camera_sub@21 {
				compatible = "mediatek,camera_sub";
				reg = <0x21>;
				status = "okay";
				linux,phandle = <0x3e>;
				phandle = <0x3e>;
			};
		};
	};

	fragment@22 {
		target = <0xffffffff>;

		__overlay__ {
			#address-cells = <0x1>;
			#size-cells = <0x0>;

			cap_touch@38 {
				compatible = "mediatek,cap_touch";
				reg = <0x38>;
				status = "okay";
				linux,phandle = <0x3f>;
				phandle = <0x3f>;
			};

			ext_buck@60 {
				compatible = "mediatek,ext_buck";
				reg = <0x60>;
				status = "okay";
				linux,phandle = <0x40>;
				phandle = <0x40>;
			};
		};
	};

	fragment@23 {
		target = <0xffffffff>;

		__overlay__ {
			#address-cells = <0x1>;
			#size-cells = <0x0>;

			strobe_main@63 {
				compatible = "mediatek,strobe_main";
				reg = <0x63>;
				status = "okay";
				linux,phandle = <0x41>;
				phandle = <0x41>;
			};
		};
	};

	fragment@24 {
		target = <0xffffffff>;

		__overlay__ {
			interrupt-parent = <0xffffffff>;
			interrupts = <0x12 0x8>;
			debounce = <0x12 0x3e800>;
			status = "okay";
		};
	};

	fragment@25 {
		target = <0xffffffff>;

		__overlay__ {
			interrupt-parent = <0xffffffff>;
			interrupts = <0x5 0x2>;
			debounce = <0x5 0x0>;
			status = "okay";
		};
	};

	fragment@26 {
		target = <0xffffffff>;

		__overlay__ {
			interrupt-parent = <0xffffffff>;
			interrupts = <0xa 0x8>;
			debounce = <0xa 0x1f400>;
			status = "okay";
		};
	};

	fragment@27 {
		target = <0xffffffff>;

		__overlay__ {
			interrupt-parent = <0xffffffff>;
			interrupts = <0x44 0x1>;
			debounce = <0x44 0x0>;
			status = "okay";
		};
	};

	fragment@28 {
		target = <0xffffffff>;

		__overlay__ {
			GPIO_FDD_BAND_SUPPORT_DETECT_1ST_PIN = <0x4>;
			GPIO_SIM1_HOT_PLUG = <0x9>;
			GPIO_SIM2_HOT_PLUG = <0xe>;
			GPIO_SIM1_SCLK = <0x16>;
			GPIO_SIM1_SIO = <0x17>;
			GPIO_SIM2_SIO = <0x18>;
			GPIO_SIM2_SCLK = <0x19>;
			GPIO_FDD_BAND_SUPPORT_DETECT_2ND_PIN = <0x22>;
		};
	};

	fragment@29 {
		target = <0xffffffff>;

		__overlay__ {

			MD1_SIM1_HOT_PLUG_EINT@0 {
				compatible = "mediatek,MD1_SIM1_HOT_PLUG_EINT-eint";
				interrupts = <0x0 0x4>;
				debounce = <0x0 0x186a0>;
				dedicated = <0x0 0x1>;
				src_pin = <0x0 0x820f078>;
				sockettype = <0x0 0x0>;
				status = "okay";
			};

			MD1_SIM2_HOT_PLUG_EINT@1 {
				compatible = "mediatek,MD1_SIM2_HOT_PLUG_EINT-eint";
				interrupts = <0x1 0x4>;
				debounce = <0x1 0x186a0>;
				dedicated = <0x1 0x1>;
				src_pin = <0x1 0x820f078>;
				sockettype = <0x1 0x0>;
				status = "okay";
			};
		};
	};

	fragment@30 {
		target = <0xffffffff>;

		__overlay__ {
			regulator-name = "vmc";
			regulator-default-on = <0x0>;
			status = "okay";
		};
	};

	fragment@31 {
		target = <0xffffffff>;

		__overlay__ {
			regulator-name = "vmch";
			regulator-default-on = <0x0>;
			status = "okay";
		};
	};

	fragment@32 {
		target = <0xffffffff>;

		__overlay__ {
			regulator-name = "vemc_3v3";
			regulator-default-on = <0x0>;
			status = "okay";
		};
	};

	fragment@33 {
		target = <0xffffffff>;

		__overlay__ {
			regulator-name = "vgp1";
			regulator-default-on = <0x0>;
			status = "okay";
		};
	};

	fragment@34 {
		target = <0xffffffff>;

		__overlay__ {
			regulator-name = "vgp2";
			regulator-default-on = <0x0>;
			status = "okay";
		};
	};

	fragment@35 {
		target = <0xffffffff>;

		__overlay__ {
			regulator-name = "vgp3";
			regulator-default-on = <0x0>;
			status = "okay";
		};
	};

	fragment@36 {
		target = <0xffffffff>;

		__overlay__ {
			regulator-name = "vcn_1v8";
			regulator-default-on = <0x0>;
			status = "okay";
		};
	};

	fragment@37 {
		target = <0xffffffff>;

		__overlay__ {
			regulator-name = "vsim1";
			regulator-default-on = <0x0>;
			status = "okay";
		};
	};

	fragment@38 {
		target = <0xffffffff>;

		__overlay__ {
			regulator-name = "vsim2";
			regulator-default-on = <0x0>;
			status = "okay";
		};
	};

	fragment@39 {
		target = <0xffffffff>;

		__overlay__ {
			regulator-name = "vcamaf";
			regulator-default-on = <0x0>;
			status = "okay";
		};
	};

	fragment@40 {
		target = <0xffffffff>;

		__overlay__ {
			regulator-name = "vibr";
			regulator-default-on = <0x0>;
			status = "okay";
		};
	};

	fragment@41 {
		target = <0xffffffff>;

		__overlay__ {
			regulator-name = "vm";
			regulator-default-on = <0x0>;
			status = "okay";
		};
	};

	fragment@42 {
		target = <0xffffffff>;

		__overlay__ {
			regulator-name = "vrf18";
			regulator-default-on = <0x0>;
			status = "okay";
		};
	};

	fragment@43 {
		target = <0xffffffff>;

		__overlay__ {
			regulator-name = "vcamd";
			regulator-default-on = <0x0>;
			status = "okay";
		};
	};

	fragment@44 {
		target = <0xffffffff>;

		__overlay__ {
			regulator-name = "vcanio";
			regulator-default-on = <0x0>;
			status = "okay";
		};
	};

	fragment@45 {
		target = <0xffffffff>;

		__overlay__ {
			regulator-name = "vcama";
			regulator-default-on = <0x0>;
			status = "okay";
		};
	};

	fragment@46 {
		target = <0xffffffff>;

		__overlay__ {
			regulator-name = "vcn33";
			regulator-default-on = <0x0>;
			status = "okay";
		};
	};

	fragment@47 {
		target = <0xffffffff>;

		__overlay__ {
			regulator-name = "vcn28";
			regulator-default-on = <0x0>;
			status = "okay";
		};
	};

	fragment@48 {
		target = <0xffffffff>;

		__overlay__ {
			vcamaf-supply = <0xffffffff>;
			vcamd-supply = <0xffffffff>;
			vcamd_main2-supply = <0xffffffff>;
			vcamd_sub-supply = <0xffffffff>;
			vcamio-supply = <0xffffffff>;
			vcamio_main2-supply = <0xffffffff>;
			vcamio_sub-supply = <0xffffffff>;
			vcama-supply = <0xffffffff>;
			vcama_main2-supply = <0xffffffff>;
			vcama_sub-supply = <0xffffffff>;
			status = "okay";
		};
	};

	fragment@49 {
		target = <0xffffffff>;

		__overlay__ {
			vtouch-supply = <0xffffffff>;
			status = "okay";
		};
	};

	fragment@50 {
		target = <0xffffffff>;

		__overlay__ {

			adc_channel@ {
				compatible = "mediatek,adc_channel";
				mediatek,temperature0 = <0x0>;
				mediatek,temperature1 = <0x1>;
				status = "okay";
			};
		};
	};

	fragment@51 {
		target = <0xffffffff>;

		__overlay__ {
			mediatek,clkbuf-quantity = <0x4>;
			mediatek,clkbuf-config = <0x2 0x2 0x1 0x1>;
			status = "okay";
		};
	};

	fragment@52 {
		target = <0xffffffff>;

		__overlay__ {
			mediatek,kpd-key-debounce = <0x400>;
			mediatek,kpd-sw-pwrkey = <0x74>;
			mediatek,kpd-hw-pwrkey = <0x8>;
			mediatek,kpd-use-extend-type = <0x0>;
			mediatek,kpd-hw-map-num = <0x48>;
			mediatek,kpd-hw-init-map = <0x0 0x0 0x0 0x0 0x0 0x0 0x0 0x0 0x0 0x0 0x0 0x0 0x0 0x0 0x0 0x0 0x0 0x0 0x0 0x0 0x0 0x0 0x0 0x0 0x0 0x0 0x0 0x0 0x0 0x0 0x0 0x0 0x0 0x0 0x0 0x0 0x0 0x0 0x0 0x0 0x0 0x0 0x0 0x0 0x0 0x0 0x0 0x0 0x0 0x0 0x0 0x0 0x0 0x0 0x0 0x0 0x0 0x0 0x0 0x0 0x0 0x0 0x0 0x73 0x72 0x0 0x0 0x0 0x0 0x0 0x0 0x0>;
			mediatek,kpd-pwrkey-eint-gpio = <0x0>;
			mediatek,kpd-pwkey-gpio-din = <0x0>;
			mediatek,kpd-hw-dl-key0 = <0x3f>;
			mediatek,kpd-hw-dl-key1 = <0x40>;
			mediatek,kpd-hw-dl-key2 = <0x8>;
			mediatek,kpd-hw-recovery-key = <0x3f>;
			mediatek,kpd-hw-factory-key = <0x40>;
			status = "okay";
		};
	};

	__symbols__ {
		vibrator0 = "/fragment@2/__overlay__/vibrator@0";
		fm_short = "/fragment@2/__overlay__/fm_short";
		fingerprint = "/fragment@2/__overlay__/fingerprint";
		mmc0_pins_default = "/fragment@6/__overlay__/mmc0@default";
		mmc0_register_setting_default = "/fragment@6/__overlay__/mmc0@register_default";
		mmc1_pins_default = "/fragment@6/__overlay__/mmc1@default";
		mmc1_pins_insert_default = "/fragment@6/__overlay__/mmc1_ins_default";
		mmc1_pins_insert_cfg = "/fragment@6/__overlay__/mmc1_ins_cfg";
		mmc1_pins_sdr104 = "/fragment@6/__overlay__/mmc1@sdr104";
		mmc1_pins_sdr50 = "/fragment@6/__overlay__/mmc1@sdr50";
		mmc1_pins_ddr50 = "/fragment@6/__overlay__/mmc1@ddr50";
		mmc1_register_setting_default = "/fragment@6/__overlay__/mmc1@register_default";
		alsps_intpin_cfg = "/fragment@7/__overlay__/alspspincfg";
		alsps_intpin_default = "/fragment@7/__overlay__/alspsdefaultcfg";
		ACCDET_pins_default = "/fragment@9/__overlay__/eint0default";
		ACCDET_pins_eint_as_int = "/fragment@9/__overlay__/eint@0";
		ctp_pins_default = "/fragment@11/__overlay__/toucheint5default";
		ctp_pins_eint_as_int = "/fragment@11/__overlay__/toucheint@5";
		ctp_pins_eint_output0 = "/fragment@11/__overlay__/eintoutput0";
		ctp_pins_eint_output1 = "/fragment@11/__overlay__/eintoutput1";
		ctp_pins_rst_output0 = "/fragment@11/__overlay__/rstoutput0";
		ctp_pins_rst_output1 = "/fragment@11/__overlay__/rstoutput1";
		AUD_pins_default = "/fragment@13/__overlay__/audiodefault";
		AUD_pins_pmicclk_mode0 = "/fragment@13/__overlay__/pmicclkmode0";
		AUD_pins_pmicclk_mode1 = "/fragment@13/__overlay__/pmicclkmode1";
		Aud_pins_extamp_high = "/fragment@13/__overlay__/audexamphigh";
		Aud_pins_extamp_low = "/fragment@13/__overlay__/audexamplow";
		mtkfb_pins_mode_te_gpio = "/fragment@14/__overlay__/mode_te_gpio";
		mtkfb_pins_mode_te_te = "/fragment@14/__overlay__/mode_te_te";
		mtkfb_pins_lcm_reset0 = "/fragment@14/__overlay__/lcm_rst_out0_gpio";
		mtkfb_pins_lcm_reset1 = "/fragment@14/__overlay__/lcm_rst_out1_gpio";
		mtkfb_pins_pwm_test_pin_mux_gpio66 = "/fragment@14/__overlay__/pwm_test_pin_mux_gpio66";
		mtkfb_pins_default = "/fragment@14/__overlay__/mtkfb_default";
		camera_pins_cam0_rst0 = "/fragment@16/__overlay__/cam0@0";
		camera_pins_cam0_rst1 = "/fragment@16/__overlay__/cam0@1";
		camera_pins_cam0_pnd0 = "/fragment@16/__overlay__/cam0@2";
		camera_pins_cam0_pnd1 = "/fragment@16/__overlay__/cam0@3";
		camera_pins_cam1_rst0 = "/fragment@16/__overlay__/cam1@0";
		camera_pins_cam1_rst1 = "/fragment@16/__overlay__/cam1@1";
		camera_pins_cam1_pnd0 = "/fragment@16/__overlay__/cam1@2";
		camera_pins_cam1_pnd1 = "/fragment@16/__overlay__/cam1@3";
		camera_pins_cam_ldo0_0 = "/fragment@16/__overlay__/cam@0";
		camera_pins_cam_ldo0_1 = "/fragment@16/__overlay__/cam@1";
		camera_pins_default = "/fragment@16/__overlay__/camdefault";
		camera_pins_cam1_gpio_serial = "/fragment@16/__overlay__/cam1serial@0";
		camera_pins_cam1_gpio_mipi = "/fragment@16/__overlay__/cam1mipi@0";
		camera_pins_cam_mclk1_enable = "/fragment@16/__overlay__/mclk1enable@0";
		camera_pins_cam_mclk1_disable = "/fragment@16/__overlay__/mclk1disable@0";
		camera_pins_cam_mclk2_enable = "/fragment@16/__overlay__/mclk2enable@0";
		camera_pins_cam_mclk2_disable = "/fragment@16/__overlay__/mclk2disable@0";
		consys_pins_default = "/fragment@18/__overlay__/consys_default";
		gpslna_pins_init = "/fragment@18/__overlay__/gpslna@0";
		gpslna_pins_oh = "/fragment@18/__overlay__/gpslna@1";
		gpslna_pins_ol = "/fragment@18/__overlay__/gpslna@2";
		fingerprint_default = "/fragment@20/__overlay__/fingerprint_default";
		fingerprint_eint = "/fragment@20/__overlay__/gpio11_eint";
		fingerprint_eint_pull_down = "/fragment@20/__overlay__/gpio11_eint_pull_down";
		fingerprint_rst_one = "/fragment@20/__overlay__/rst_out_one";
		fingerprint_rst_zero = "/fragment@20/__overlay__/rst_out_zero";
		camera_main_mtk = "/fragment@21/__overlay__/camera_main@36";
		camera_main_af_mtk = "/fragment@21/__overlay__/camera_main_af@18";
		camera_sub_mtk = "/fragment@21/__overlay__/camera_sub@21";
		cap_touch_mtk = "/fragment@22/__overlay__/cap_touch@38";
		ext_buck_mtk = "/fragment@22/__overlay__/ext_buck@60";
		strobe_main_mtk = "/fragment@23/__overlay__/strobe_main@63";
	};

	__fixups__ {
		chosen = "/fragment@0:target:0";
		bus = "/fragment@1:target:0";
		odm = "/fragment@2:target:0";
		pio = "/fragment@2/__overlay__/fm_short:gpio-short-antenna:0", "/fragment@5/__overlay__:cd-gpios:0", "/fragment@6:target:0", "/fragment@7:target:0", "/fragment@9:target:0", "/fragment@11:target:0", "/fragment@13:target:0", "/fragment@14:target:0", "/fragment@16:target:0", "/fragment@18:target:0", "/fragment@20:target:0";
		eintc = "/fragment@2/__overlay__/fingerprint:interrupt-parent:0", "/fragment@3/__overlay__/alsps_stk3x1x@48:interrupt-parent:0", "/fragment@24/__overlay__:interrupt-parent:0", "/fragment@25/__overlay__:interrupt-parent:0", "/fragment@26/__overlay__:interrupt-parent:0", "/fragment@27/__overlay__:interrupt-parent:0", "/fragment@29:target:0";
		i2c2 = "/fragment@3:target:0", "/fragment@23:target:0";
		mmc0 = "/fragment@4:target:0";
		mmc1 = "/fragment@5:target:0";
		accdet = "/fragment@8:target:0", "/fragment@24:target:0";
		touch = "/fragment@10:target:0", "/fragment@25:target:0", "/fragment@49:target:0";
		audgpio = "/fragment@12:target:0";
		mtkfb = "/fragment@15:target:0";
		kd_camera_hw1 = "/fragment@17:target:0", "/fragment@48:target:0";
		consys = "/fragment@19:target:0";
		i2c0 = "/fragment@21:target:0";
		i2c1 = "/fragment@22:target:0";
		msdc1_ins = "/fragment@26:target:0";
		dsi_te = "/fragment@27:target:0";
		gpio_usage_mapping = "/fragment@28:target:0";
		mt_pmic_vmc_ldo_reg = "/fragment@30:target:0";
		mt_pmic_vmch_ldo_reg = "/fragment@31:target:0";
		mt_pmic_vemc_3v3_ldo_reg = "/fragment@32:target:0";
		mt_pmic_vgp1_ldo_reg = "/fragment@33:target:0", "/fragment@49/__overlay__:vtouch-supply:0";
		mt_pmic_vgp2_ldo_reg = "/fragment@34:target:0";
		mt_pmic_vgp3_ldo_reg = "/fragment@35:target:0";
		mt_pmic_vcn_1v8_ldo_reg = "/fragment@36:target:0";
		mt_pmic_vsim1_ldo_reg = "/fragment@37:target:0";
		mt_pmic_vsim2_ldo_reg = "/fragment@38:target:0";
		mt_pmic_vcamaf_ldo_reg = "/fragment@39:target:0", "/fragment@48/__overlay__:vcamaf-supply:0";
		mt_pmic_vibr_ldo_reg = "/fragment@40:target:0";
		mt_pmic_vm_ldo_reg = "/fragment@41:target:0";
		mt_pmic_vrf18_ldo_reg = "/fragment@42:target:0";
		mt_pmic_vcamd_ldo_reg = "/fragment@43:target:0", "/fragment@48/__overlay__:vcamd-supply:0", "/fragment@48/__overlay__:vcamd_main2-supply:0", "/fragment@48/__overlay__:vcamd_sub-supply:0";
		mt_pmic_vcanio_ldo_reg = "/fragment@44:target:0", "/fragment@48/__overlay__:vcamio-supply:0", "/fragment@48/__overlay__:vcamio_main2-supply:0", "/fragment@48/__overlay__:vcamio_sub-supply:0";
		mt_pmic_vcama_ldo_reg = "/fragment@45:target:0", "/fragment@48/__overlay__:vcama-supply:0", "/fragment@48/__overlay__:vcama_main2-supply:0", "/fragment@48/__overlay__:vcama_sub-supply:0";
		mt_pmic_vcn33_ldo_reg = "/fragment@46:target:0";
		mt_pmic_vcn28_ldo_reg = "/fragment@47:target:0";
		auxadc = "/fragment@50:target:0";
		rf_clock_buffer_ctrl = "/fragment@51:target:0";
		keypad = "/fragment@52:target:0";
	};

	__local_fixups__ {

		fragment@2 {

			__overlay__ {

				fingerprint {
					pinctrl-0 = <0x0>;
					pinctrl-1 = <0x0>;
					pinctrl-2 = <0x0>;
					pinctrl-3 = <0x0>;
					pinctrl-4 = <0x0>;
				};
			};
		};

		fragment@3 {

			__overlay__ {

				alsps_stk3x1x@48 {
					pinctrl-0 = <0x0>;
					pinctrl-1 = <0x0>;
				};
			};
		};

		fragment@4 {

			__overlay__ {
				pinctl = <0x0>;
				register_setting = <0x0>;
			};
		};

		fragment@5 {

			__overlay__ {
				pinctrl-0 = <0x0>;
				pinctrl-1 = <0x0>;
				pinctl = <0x0>;
				pinctl_sdr104 = <0x0>;
				pinctl_sdr50 = <0x0>;
				pinctl_ddr50 = <0x0>;
				register_setting = <0x0>;
			};
		};

		fragment@8 {

			__overlay__ {
				pinctrl-0 = <0x0>;
				pinctrl-1 = <0x0>;
			};
		};

		fragment@10 {

			__overlay__ {
				pinctrl-0 = <0x0>;
				pinctrl-1 = <0x0>;
				pinctrl-2 = <0x0>;
				pinctrl-3 = <0x0>;
				pinctrl-4 = <0x0>;
				pinctrl-5 = <0x0>;
			};
		};

		fragment@12 {

			__overlay__ {
				pinctrl-0 = <0x0>;
				pinctrl-1 = <0x0>;
				pinctrl-2 = <0x0>;
				pinctrl-3 = <0x0>;
				pinctrl-4 = <0x0>;
			};
		};

		fragment@15 {

			__overlay__ {
				pinctrl-0 = <0x0>;
				pinctrl-1 = <0x0>;
				pinctrl-2 = <0x0>;
				pinctrl-3 = <0x0>;
				pinctrl-4 = <0x0>;
				pinctrl-5 = <0x0>;
			};
		};

		fragment@17 {

			__overlay__ {
				pinctrl-0 = <0x0>;
				pinctrl-1 = <0x0>;
				pinctrl-2 = <0x0>;
				pinctrl-3 = <0x0>;
				pinctrl-4 = <0x0>;
				pinctrl-5 = <0x0>;
				pinctrl-6 = <0x0>;
				pinctrl-7 = <0x0>;
				pinctrl-8 = <0x0>;
				pinctrl-9 = <0x0>;
				pinctrl-10 = <0x0>;
				pinctrl-11 = <0x0>;
				pinctrl-12 = <0x0>;
				pinctrl-13 = <0x0>;
				pinctrl-14 = <0x0>;
				pinctrl-15 = <0x0>;
				pinctrl-16 = <0x0>;
			};
		};

		fragment@19 {

			__overlay__ {
				pinctrl-0 = <0x0>;
				pinctrl-1 = <0x0>;
				pinctrl-2 = <0x0>;
				pinctrl-3 = <0x0>;
			};
		};
	};
};
